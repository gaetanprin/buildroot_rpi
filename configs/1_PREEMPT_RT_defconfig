## configs/1_PREEMPT_RT_defconfig
```kconfig
#########################################################
# CONFIG : PREEMPT_RT (23/07/15 - 09:03)		#
#########################################################
BR2_arm=y
BR2_arm1176jzf_s=y
BR2_DL_DIR="$(TOPDIR)/dl"
BR2_TOOLCHAIN=y
BR2_TOOLCHAIN_USES_UCLIBC=y
BR2_TOOLCHAIN_BUILDROOT=y
BR2_TOOLCHAIN_BUILDROOT_VENDOR="buildroot"
BR2_KERNEL_HEADERS_4_0=y
BR2_DEFAULT_KERNEL_HEADERS="4.0.4"
BR2_TOOLCHAIN_BUILDROOT_UCLIBC=y
BR2_TOOLCHAIN_BUILDROOT_LIBC="uclibc"
BR2_PACKAGE_UCLIBC=y
BR2_TOOLCHAIN_BUILDROOT_WCHAR=y
BR2_UCLIBC_INSTALL_UTILS=y
BR2_UCLIBC_TARGET_ARCH="arm"
BR2_UCLIBC_ARM_BX=y
BR2_BINUTILS_VERSION_2_24=y
BR2_BINUTILS_VERSION="2.24"
BR2_TARGET_GENERIC_HOSTNAME="rpi"
#########################################################
# MODIFICATION						#
#########################################################
BR2_TARGET_GENERIC_ISSUE="Kernel Linux 3.18.16 v(PREEMPT-RT)"
BR2_TARGET_GENERIC_GETTY_PORT="ttyAMA0"
BR2_ROOTFS_POST_SCRIPT_ARGS="sdhci-bcm2708.enable_llm=0"
BR2_LINUX_KERNEL=y
BR2_LINUX_KERNEL_CUSTOM_GIT=y
BR2_LINUX_KERNEL_CUSTOM_REPO_URL="git://github.com/raspberrypi/linux.git"
BR2_LINUX_KERNEL_CUSTOM_REPO_VERSION="786219b8"
BR2_LINUX_KERNEL_PATCH="board/raspberrypi/3.18.16/PREEMPT_RT"
BR2_LINUX_KERNEL_USE_DEFCONFIG=y
BR2_LINUX_KERNEL_DEFCONFIG="bcmrpi_quick"
	#BR2_LINUX_KERNEL_USE_CUSTOM_CONFIG=y
	#BR2_LINUX_KERNEL_CUSTOM_CONFIG_FILE="board/raspberrypi/3.18.16/PREEMPT_RT/PREEMPT_RT_defconfig"
BR2_LINUX_KERNEL_ZIMAGE=y
BR2_NEEDS_GETTEXT=y
BR2_USE_MMU=y
#########################################################
# PACKAGE						#
#########################################################
BR2_PACKAGE_BUSYBOX_SHOW_OTHERS=y
BR2_SYSTEM_BIN_SH_BASH=y
BR2_PACKAGE_RT_TESTS=y
BR2_PACKAGE_RPI_FIRMWARE=y
BR2_PACKAGE_GNUPLOT=y
BR2_PACKAGE_LIBCOFI=y
BR2_PACKAGE_DROPBEAR=y
BR2_PACKAGE_GD=y
BR2_PACKAGE_GDK_PIXBUF=y
BR2_PACKAGE_LIBPNG=y
BR2_PACKAGE_CGIC=y
BR2_PACKAGE_LIBCGI=y
BR2_PACKAGE_APR=y
BR2_PACKAGE_APR_UTIL=y
BR2_PACKAGE_PCRE=y
BR2_PACKAGE_APACHE=y
BR2_PACKAGE_BASH=y
BR2_PACKAGE_SUDO=y
BR2_PACKAGE_VIM=y
BR2_PACKAGE_VIM_RUNTIME=y
BR2_TARGET_ROOTFS_EXT2=y
BR2_TARGET_ROOTFS_EXT2_3=y
BR2_TARGET_ROOTFS_TAR_GZIP=y
```

## configs/RASP_XENOMAI_defconfig
```kconfig
#########################################################
# CONFIG : XENOMAI (23/07/15 - 11:41)			#
#########################################################
BR2_arm=y
BR2_arm1176jzf_s=y
BR2_DL_DIR="$(TOPDIR)/dl"
BR2_TOOLCHAIN=y
BR2_TOOLCHAIN_USES_UCLIBC=y
BR2_TOOLCHAIN_BUILDROOT=y
BR2_TOOLCHAIN_BUILDROOT_VENDOR="buildroot"
BR2_KERNEL_HEADERS_4_0=y
BR2_DEFAULT_KERNEL_HEADERS="4.0.4"
BR2_TOOLCHAIN_BUILDROOT_UCLIBC=y
BR2_TOOLCHAIN_BUILDROOT_LIBC="uclibc"
BR2_PACKAGE_UCLIBC=y
BR2_TOOLCHAIN_BUILDROOT_WCHAR=y
BR2_UCLIBC_INSTALL_UTILS=y
BR2_UCLIBC_TARGET_ARCH="arm"
BR2_UCLIBC_ARM_BX=y
BR2_BINUTILS_VERSION_2_24=y
BR2_BINUTILS_VERSION="2.24"
BR2_TARGET_GENERIC_HOSTNAME="rpi"
BR2_ROOTFS_OVERLAY="board/raspberrypi/post_image_overlay"
#########################################################
# MODIFICATION						#
#########################################################
BR2_TARGET_GENERIC_ISSUE="Kernel Linux 3.18.16 v(XENOMAI_2.6.4)"
BR2_TARGET_GENERIC_GETTY_PORT="ttyAMA0"
BR2_LINUX_KERNEL=y
BR2_LINUX_KERNEL_CUSTOM_GIT=y
BR2_LINUX_KERNEL_CUSTOM_REPO_URL="git://github.com/raspberrypi/linux.git"
BR2_LINUX_KERNEL_CUSTOM_REPO_VERSION="786219b8"
BR2_LINUX_KERNEL_USE_DEFCONFIG=y
BR2_LINUX_KERNEL_DEFCONFIG="bcmrpi"
BR2_LINUX_KERNEL_ZIMAGE=y
BR2_NEEDS_GETTEXT=y
BR2_USE_MMU=y
#########################################################
# XENOMAI						#
#########################################################
BR2_LINUX_KERNEL_EXT_XENOMAI=y
BR2_PACKAGE_XENOMAI_VERSION="2.6-master"
BR2_LINUX_KERNEL_EXT_XENOMAI_ADEOS_PATCH="board/raspberrypi/3.18.16/XENOMAI/ipipe-core-3.18.12-arm-1.patch"
BR2_LINUX_KERNEL_EXT_XENOMAI_KPOST_PATCH_DIR="board/raspberrypi/3.18.16/XENOMAI/POST_KPATCH/"
BR2_PACKAGE_XENOMAI_TESTSUITE=y
BR2_PACKAGE_XENOMAI_VXWORKS_SKIN=y
#########################################################
# PACKAGE						#
#########################################################
BR2_PACKAGE_BUSYBOX=y
BR2_PACKAGE_BUSYBOX_SHOW_OTHERS=y
BR2_PACKAGE_RT_TESTS=y
BR2_PACKAGE_RPI_FIRMWARE=y
BR2_PACKAGE_GNUPLOT=y
BR2_PACKAGE_LIBCOFI=y
BR2_PACKAGE_DROPBEAR=y
BR2_PACKAGE_GD=y
BR2_PACKAGE_GDK_PIXBUF=y
BR2_PACKAGE_LIBPNG=y
BR2_PACKAGE_CGIC=y
BR2_PACKAGE_LIBCGI=y
BR2_PACKAGE_APR=y
BR2_PACKAGE_APR_UTIL=y
BR2_PACKAGE_PCRE=y
BR2_PACKAGE_APACHE=y
BR2_PACKAGE_BASH=y
BR2_PACKAGE_SUDO=y
BR2_PACKAGE_VIM=y
BR2_PACKAGE_VIM_RUNTIME=y
BR2_SYSTEM_BIN_SH_BASH=y
BR2_TARGET_ROOTFS_EXT2=y
BR2_TARGET_ROOTFS_EXT2_3=y
BR2_TARGET_ROOTFS_TAR_GZIP=y
```

## unofficial_drivers/Config.in
```kconfig
menu "Unofficial drivers"

	source "unofficial_drivers/rpi_gpio_driver/Config.in"
	source "unofficial_drivers/rpi_gpio_driver_xenomai/Config.in"
endmenu
```

## unofficial_drivers/rpi_gpio_driver/Config.in
```kconfig
config BR2_RPI_GPIO_DRV
	bool "RPi GPIO Driver Linux"
	depends on BR2_arm || !BR2_LINUX_KERNEL_EXT_XENOMAI || \
	BR2_LINUX_KERNEL
	help
	  Enable this option if you want to build a Linux kernel
	  module for your raspberry device.
	
config BR2_RPI_GPIO_DRV_XENO
        bool "RPi GPIO Driver Linux Xenomai"
        depends on BR2_arm || BR2_LINUX_KERNEL_EXT_XENOMAI || \
	BR2_LINUX_KERNEL 
        help
          Enable this option if you want to build a Linux xenomai
	  kernel module for your raspberry device.
```
